## meta-agl-container-demo/conf/layer.conf
```bitbake
# We have a conf and classes directory, add to BBPATH
BBPATH =. "${LAYERDIR}:"

# We have recipes-* directories, add to BBFILES
BBFILES += "${LAYERDIR}/recipes-*/*/*.bb \
            ${LAYERDIR}/recipes-*/*/*.bbappend"

BBFILE_COLLECTIONS += "aglcontainerdemo"
BBFILE_PATTERN_aglcontainerdemo = "^${LAYERDIR}/"
BBFILE_PRIORITY_aglcontainerdemo = "200"
LAYERSERIES_COMPAT_aglcontainerdemo = "thud"
```

## meta-agl-container-demo/meta-container-demo-guest/conf/layer.conf
```bitbake
# We have a conf and classes directory, add to BBPATH
BBPATH =. "${LAYERDIR}:"

# We have recipes-* directories, add to BBFILES
BBFILES += "${LAYERDIR}/recipes-*/*/*.bb \
            ${LAYERDIR}/recipes-*/*/*.bbappend"

BBFILE_COLLECTIONS += "aglcontainerdemoguest"
BBFILE_PATTERN_aglcontainerdemoguest = "^${LAYERDIR}/"
BBFILE_PRIORITY_aglcontainerdemoguest = "200"
LAYERSERIES_COMPAT_aglcontainerdemoguest = "dunfell"
```

## meta-agl-container-demo/meta-container-demo-host/conf/layer.conf
```bitbake
# We have a conf and classes directory, add to BBPATH
BBPATH =. "${LAYERDIR}:"

# We have recipes-* directories, add to BBFILES
BBFILES += "${LAYERDIR}/recipes-*/*/*.bb \
            ${LAYERDIR}/recipes-*/*/*.bbappend"

BBFILE_COLLECTIONS += "aglcontainerdemohost"
BBFILE_PATTERN_aglcontainerdemohost = "^${LAYERDIR}/"
BBFILE_PRIORITY_aglcontainerdemohost = "200"
LAYERSERIES_COMPAT_aglcontainerdemohost = "dunfell"
```

## meta-agl-container-demo/meta-container-ic/conf/layer.conf
```bitbake
# We have a conf and classes directory, add to BBPATH
BBPATH =. "${LAYERDIR}:"

# We have recipes-* directories, add to BBFILES
BBFILES += "${LAYERDIR}/recipes-*/*/*.bb \
            ${LAYERDIR}/recipes-*/*/*.bbappend"

BBFILE_COLLECTIONS += "aglcontainerdemoic"
BBFILE_PATTERN_aglcontainerdemoic = "^${LAYERDIR}/"
BBFILE_PRIORITY_aglcontainerdemoic = "200"
LAYERSERIES_COMPAT_aglcontainerdemoic = "thud"
```

## meta-agl-container-demo/meta-container-ivi/conf/layer.conf
```bitbake
# We have a conf and classes directory, add to BBPATH
BBPATH =. "${LAYERDIR}:"

# We have recipes-* directories, add to BBFILES
BBFILES += "${LAYERDIR}/recipes-*/*/*.bb \
            ${LAYERDIR}/recipes-*/*/*.bbappend"

BBFILE_COLLECTIONS += "aglcontainerdemoivi"
BBFILE_PATTERN_aglcontainerdemoivi = "^${LAYERDIR}/"
BBFILE_PRIORITY_aglcontainerdemoivi = "200"
LAYERSERIES_COMPAT_aglcontainerdemoivi = "thud"
```

## meta-agl-container-demo/meta-container-others/conf/layer.conf
```bitbake
# We have a conf and classes directory, add to BBPATH
BBPATH =. "${LAYERDIR}:"

# We have recipes-* directories, add to BBFILES
BBFILES += "${LAYERDIR}/recipes-*/*/*.bb \
            ${LAYERDIR}/recipes-*/*/*.bbappend"

BBFILE_COLLECTIONS += "aglcontainerdemoothers"
BBFILE_PATTERN_aglcontainerdemoothers = "^${LAYERDIR}/"
BBFILE_PRIORITY_aglcontainerdemoothers = "200"
LAYERSERIES_COMPAT_aglcontainerdemoothers = "thud"
```

## meta-agl-container/conf/layer.conf
```bitbake
# We have a conf and classes directory, add to BBPATH
BBPATH =. "${LAYERDIR}:"

# We have recipes-* directories, add to BBFILES
BBFILES += "${LAYERDIR}/recipes-*/*/*.bb \
            ${LAYERDIR}/recipes-*/*/*.bbappend"

BBFILE_COLLECTIONS += "aglcontainer"
BBFILE_PATTERN_aglcontainer = "^${LAYERDIR}/"
BBFILE_PRIORITY_aglcontainer = "100"
LAYERSERIES_COMPAT_aglcontainer = "dunfell"

# Workaround: missing cfg/virtio.scc in rcar-gen3 bsp kernel
BBFILES_DYNAMIC_append = " \
    rcar-gen3:${LAYERDIR}/dynamic-layers/rcar-gen3/*/*/*.bbappend \
    "
```

## meta-agl-container/meta-container-guest/conf/layer.conf
```bitbake
# We have a conf and classes directory, add to BBPATH
BBPATH =. "${LAYERDIR}:"

# We have recipes-* directories, add to BBFILES
BBFILES += "${LAYERDIR}/recipes-*/*/*.bb \
            ${LAYERDIR}/recipes-*/*/*.bbappend"

BBFILE_COLLECTIONS += "aglcontainerguest"
BBFILE_PATTERN_aglcontainerguest = "^${LAYERDIR}/"
BBFILE_PRIORITY_aglcontainerguest = "100"
LAYERSERIES_COMPAT_aglcontainerguest = "dunfell"
```

## meta-agl-container/meta-container-host/conf/layer.conf
```bitbake
# We have a conf and classes directory, add to BBPATH
BBPATH =. "${LAYERDIR}:"

# We have recipes-* directories, add to BBFILES
BBFILES += "${LAYERDIR}/recipes-*/*/*.bb \
            ${LAYERDIR}/recipes-*/*/*.bbappend"

BBFILE_COLLECTIONS += "aglcontainerhost"
BBFILE_PATTERN_aglcontainerhost = "^${LAYERDIR}/"
BBFILE_PRIORITY_aglcontainerhost = "100"
LAYERSERIES_COMPAT_aglcontainerhost = "thud"
```
